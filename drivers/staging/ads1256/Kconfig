## drivers/staging/ads1256/Kconfig
```kconfig
#
# ADC drivers
#
menu "Texas Instuments analog to digital converters"

config ADS1256
    tristate "Texas Instruments ADS1256 ADC driver"
    depends on SPI 
    help
      Say yes here to build driver for Texas Instruments ADS1256
      ADC.

      To compile this driver as a module, choose M here: the 
      module will be called ads1256.

endmenu
```
